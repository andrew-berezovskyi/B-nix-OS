## linux/Config.in
```kconfig
menu "B-nix components"
source "$BR2_EXTERNAL_BNIX_PATH/package/bnix-shell/Config.in"
endmenu
```

## linux/package/bnix-shell/Config.in
```kconfig
config BR2_PACKAGE_BNIX_SHELL
	bool "bnix-shell"
	help
	  B-nix-owned lightweight graphical session for the reference
	  QEMU platform. It renders responsive desktop chrome directly
	  through the Linux framebuffer while the Wayland compositor
	  milestone is developed.
```
